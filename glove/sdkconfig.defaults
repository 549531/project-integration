## glove/sdkconfig.defaults
```kconfig
CONFIG_PARTITION_TABLE_SINGLE_APP_LARGE=y
CONFIG_ESP32_REV_MIN_3_1=y
CONFIG_ESP_SYSTEM_PANIC_PRINT_HALT=y
CONFIG_ESP_CONSOLE_UART_CUSTOM=y
CONFIG_ESP_CONSOLE_UART_BAUDRATE=921600
CONFIG_FREERTOS_HZ=1000
CONFIG_LOG_MAXIMUM_LEVEL_VERBOSE=y
CONFIG_MBEDTLS_PSK_MODES=y
CONFIG_NEWLIB_NANO_FORMAT=y
```
